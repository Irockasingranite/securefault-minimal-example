## CMakeLists.txt
```
cmake_minimum_required(VERSION 3.20.0)

find_package(Zephyr REQUIRED HINTS $ENV{ZEPHYR_BASE})
project("SecureFault Example" VERSION 0.1)

target_sources(app PRIVATE
    src/main.c
)

target_include_directories(app PRIVATE
    src
)
```

## Kconfig
```
menu "SecureFault Example"

module = MAIN
module-str = "main"
source "subsys/logging/Kconfig.template.log_config"

endmenu

menu "Zephyr Kernel"
source "Kconfig.zephyr"
endmenu
```

## west.yml
```
manifest:
  remotes:
    - name: ncs
      url-base: https://github.com/nrfconnect
    - name: u-blox
      url-base: https://github.com/u-blox
  
  projects:
    - name: sdk-nrf
      path: nrf
      remote: ncs
      repo-path: sdk-nrf
      revision: v2.5.0
      import: true
  
    - name: ubxlib
      path: modules/lib/ubxlib
      remote: u-blox
      repo-path: ubxlib
      revision: 9694ef9d70e6e7d90562174e8c4d52555d8730da # master as of 2024-02-23
      submodules: true
      clone-depth: 1
```

## prj.conf
```kconfig
# ubxlib
CONFIG_UBXLIB=y

# Logging
CONFIG_LOG=y

# TFM debug logs
CONFIG_TFM_SECURE_UART0=y
CONFIG_TFM_LOG_LEVEL_SILENCE=n
CONFIG_TFM_EXCEPTION_INFO_DUMP=y
CONFIG_TFM_SPM_LOG_LEVEL_DEBUG=y
```

## src/main.c
```c
#include <zephyr/kernel.h>

#include <zephyr/logging/log.h>
LOG_MODULE_REGISTER(main, CONFIG_MAIN_LOG_LEVEL);

int main(int argc, char *argv[]) {

	LOG_INF("Hello world!");

	return 0;
}
```
